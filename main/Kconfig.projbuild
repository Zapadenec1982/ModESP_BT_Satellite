## main/Kconfig.projbuild
```kconfig
menu "Satellite"

choice SAT_LINK_PORT
    prompt "UART that carries the link to the host"
    default SAT_LINK_UART2
    help
        UART2 on GPIO17 (TX) and GPIO16 (RX) is the DevKitC configuration. UART0 on
        that board belongs to the USB bridge, which flashes it and shows its console.

        UART0 on GPIO1 (TX) and GPIO3 (RX) is the bare-module configuration. The
        host reaches the ROM bootloader over the same two wires, so it flashes this
        device and talks to it on one pair. Nothing else may speak on UART0 then:
        build with sdkconfig.bare, which turns the console off.

config SAT_LINK_UART2
    bool "UART2, GPIO17/16 (DevKitC)"

config SAT_LINK_UART0
    bool "UART0, GPIO1/3 (bare module, flashed by the host)"

endchoice

config SAT_LINK_LOOPBACK
    bool "Loop the control link back on itself"
    default n
    help
        Wires UART2's transmitter to its own receiver inside the chip, so every
        frame the device sends arrives back at it. There is no host on the other
        end and none is needed.

        This exists because the link can be brought up and exercised long before
        the other board is on the bench: framing, CRC, sequence numbers, the
        drop policy and the PING/PONG exchange are all observable with nothing
        attached to GPIO17 and GPIO16.

        Never ship it enabled. The device would answer its own PING and report a
        host that is not there.

config SAT_LINK_ONLY
    bool "Build the link and nothing else"
    default n
    help
        Brings up the UART link, HELLO, PING/PONG and LOG, and leaves out
        Bluetooth and I2S entirely.

        It exists to make a first failure legible. With the radio in the picture
        a silent link could be the wire, the baud rate, the framing, the CRC, the
        Bluetooth stack or the phone; without it, the list is four items long and
        all four are on this side of the cable.

        The HELLO from this build declares no A2DP bits, because it has no A2DP
        and the host takes that declaration at its word.

config SAT_CLOCK_PROBE
    bool "Measure the I2S bit clock and log it"
    default n
    help
        Counts edges on the BCLK and WS pads through their input buffers and
        reports the frequency every six seconds, without ever driving them. No
        wire and no oscilloscope.

        It exists because "does the clock keep running when nothing is playing"
        is a question the host's receiver depends on, and one that deserves a
        measurement rather than a reading of the driver source.

endmenu
```
